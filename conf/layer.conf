## conf/layer.conf
```bitbake
# Copyright (C) 2019 Oliver Stäbler <oliver.staebler@bytesatwork.ch>
# Released under the MIT license (see COPYING.MIT for the terms)

# We have a conf and classes directory, add to BBPATH
BBPATH =. "${LAYERDIR}:"

# We have recipes-* directories, add to BBFILES
BBFILES += "${LAYERDIR}/recipes-*/*/*.bb \
            ${LAYERDIR}/recipes-*/*/*.bbappend"

BBFILE_COLLECTIONS += "meta-bytesatwork-st"
BBFILE_PATTERN_meta-bytesatwork-st = "^${LAYERDIR}/"
BBFILE_PRIORITY_meta-bytesatwork-st = "8"

LAYERDEPENDS_meta-bytesatwork-st = " \
	stm-st-stm32mp \
"

LAYERSERIES_COMPAT_meta-bytesatwork-st = "gatesgarth"
```

## conf/machine/bytedevkit-stm32mp1.conf
```bitbake
# Copyright (C) 2022 bytes at work AG - https://www.bytesatwork.io
# Released under the MIT license (see COPYING.MIT for the terms)

#@TYPE: Machine
#@NAME: byteDEVKIT
#@DESCRIPTION: byteDEVKIT by bytes at work AG

require include/byteengine-stm32mp1.inc

# Do not remove any partitions from rootfs (/boot is needed for rauc)
PARTITIONS_MOUNTPOINT_IMAGE:remove = "${STM32MP_BOOTFS_MOUNTPOINT_IMAGE}"
PARTITIONS_MOUNTPOINT_IMAGE:remove = "${STM32MP_USERFS_MOUNTPOINT_IMAGE}"
PARTITIONS_MOUNTPOINT_IMAGE:remove = "${STM32MP_VENDORFS_MOUNTPOINT_IMAGE}"

MACHINE_ESSENTIAL_EXTRA_RDEPENDS = "kernel-imagebootfs"

# Generic STM32 configuration
STM32MP_DEVICETREE = "stm32mp157c-bytedevkit-v1-1 stm32mp157c-bytedevkit-v1-3"
BOOTSCHEME_LABELS = "opteemin sdcard nor-sdcard"

STM32MP_DEVICETREE_PROGRAMMER_ENABLE = "0"

STM32MP_DT_FILES_NOR     += "stm32mp157c-bytedevkit-v1-1 stm32mp157c-bytedevkit-v1-3"
STM32MP_DT_FILES_SDCARD  += "stm32mp157c-bytedevkit-v1-1 stm32mp157c-bytedevkit-v1-3"

# U-boot extra configuration
UBOOT_CONFIG = "default_stm32mp15"
UBOOT_CONFIG[default_stm32mp15] = "stm32mp157_bytedevkit_defconfig,,u-boot.dtb"
UBOOT_DEVICETREE[default_stm32mp15] = "stm32mp157c-bytedevkit-v1-1 stm32mp157c-bytedevkit-v1-3"
UBOOT_DEVICETREE[1gram] = "stm32mp157c-bytedevkit-v1-1 stm32mp157c-bytedevkit-v1-3"

# build tf-a artifacts for SD card and NOR
STM32MP_DT_FILES_SDCARD = "stm32mp157c-bytedevkit-v1-3"
STM32MP_DT_FILES_NOR = "stm32mp157c-bytedevkit-v1-3"

WKS_FILE = "stm32mp1-sdcard-tfa-optee.wks"
WKS_FILE_DEPENDS ?= " \
    virtual/bootloader \
    virtual/trusted-firmware-a \
    ${@bb.utils.contains('BOOTSCHEME_LABELS', 'optee', 'virtual-optee-os', '', d)} \
"
```

## conf/machine/include/byteengine-stm32mp1.inc
```bitbake
# Copyright (C) 2022 bytes at work AG - https://www.bytesatwork.io
# Released under the MIT license (see COPYING.MIT for the terms)

#@TYPE: Machine
#@NAME: byteENGINE STM32MP1
#@DESCRIPTION: byteENGINE STM32MP1 by bytes at work AG

MACHINEOVERRIDES =. "stm32mp1common:stm32mp15common:"

include conf/machine/include/st-machine-common-stm32mp.inc
include conf/machine/include/st-machine-providers-stm32mp.inc

DEFAULTTUNE = "cortexa7thf-neon-vfpv4"
include conf/machine/include/arm/armv7a/tune-cortexa7.inc

PREFERRED_PROVIDER_virtual/bootloader = "u-boot-stm32mp"
PREFERRED_PROVIDER_virtual/kernel = "linux-stm32mp"

# default kernel load address
ST_KERNEL_LOADADDR = "0xC2000040"

# install kernel modules
MACHINE_ESSENTIAL_EXTRA_RRECOMMENDS += "kernel-modules"

# Set the variable used by meta-st-stm32mp with the yocto standard variable.
# Without this, we cannot create images bigger than ~700MB.
ROOTFS_PARTITION_SIZE = "${IMAGE_ROOTFS_SIZE}"
IMAGE_ROOTFS_MAXSIZE = "8000000000"

# wic
ENABLE_FLASHLAYOUT_CONFIG = "0"
ENABLE_PARTITIONS_IMAGE = "0"
WKS_FILE = "stm32mp1.wks"
IMAGE_FSTYPES += "wic.gz wic.bmap"
UBOOT_BINARY = "u-boot.img"
IMAGE_BOOT_FILES = "${KERNEL_IMAGETYPE} ${KERNEL_DEVICETREE}"

SPDX_WORKAROUND ??= "create-spdx"
INHERIT:remove = "${SPDX_WORKAROUND}"
```

## wic/stm32mp1-sdcard-tfa-optee.wks
```
# short-description: Create SD card image for stm32mp1
# long-description: Creates a partitioned SD card image for stm32mp1

# FSBL partitions aka TF-A BL2
part fsbl1 --source rawcopy --fstype=ext4 --fsoptions "noauto" --part-name=fsbl1 --sourceparams="file=${DEPLOY_DIR_IMAGE}/arm-trusted-firmware/tf-a-stm32mp157c-bytedevkit-v1-3-opteemin-sdcard.stm32" --ondisk mmcblk --part-type 0x8301 --fixed-size 256K --align 17
part fsbl2 --source rawcopy --fstype=ext4 --fsoptions "noauto" --part-name=fsbl2 --sourceparams="file=${DEPLOY_DIR_IMAGE}/arm-trusted-firmware/tf-a-stm32mp157c-bytedevkit-v1-3-opteemin-sdcard.stm32" --ondisk mmcblk --part-type 0x8301 --fixed-size 256K

# Metadata partitions
part metadata1 --source rawcopy --fstype=ext4 --fsoptions "noauto" --part-name=metadata1 --sourceparams="file=${DEPLOY_DIR_IMAGE}/arm-trusted-firmware/metadata.bin" --ondisk mmcblk --part-type 0x8301 --fixed-size 256K
part metadata2 --source rawcopy --fstype=ext4 --fsoptions "noauto" --part-name=metadata2 --sourceparams="file=${DEPLOY_DIR_IMAGE}/arm-trusted-firmware/metadata.bin" --ondisk mmcblk --part-type 0x8301 --fixed-size 256K

# Fip partitions
part fip-a   --source rawcopy --fstype=ext4 --fsoptions "noauto" --part-name=fip-a --sourceparams="file=${DEPLOY_DIR_IMAGE}/fip/fip-stm32mp157c-bytedevkit-v1-3-opteemin-sdcard.bin" --ondisk mmcblk --part-type 19d5df83-11b0-457b-be2c-7559c13142a5 --fixed-size 4096K --uuid 4fd84c93-54ef-463f-a7ef-ae25ff887087
part fip-b   --source rawcopy --fstype=ext4 --fsoptions "noauto" --part-name=fip-b --sourceparams="file=${DEPLOY_DIR_IMAGE}/fip/fip-stm32mp157c-bytedevkit-v1-3-opteemin-sdcard.bin" --ondisk mmcblk --part-type 19d5df83-11b0-457b-be2c-7559c13142a5 --fixed-size 4096K --uuid 09c54952-d5bf-45af-acee-335303766fb3

# Rootfs
part /      --source rootfs --ondisk mmcblk0 --fstype=ext4 --label root --align 4096 --size 2G

bootloader --ptable gpt
```
