## conf/machine/bytedevkit-stm32mp2.conf
```bitbake
# Copyright (C) 2025 bytesatwork AG - https://www.bytesatwork.io
# Released under the MIT license (see COPYING.MIT for the terms)

#@TYPE: Machine
#@NAME: byteDEVKIT STM32MP2
#@DESCRIPTION: byteDEVKIT STM32MP2 by bytesatwork AG

require include/byteengine-stm32mp2.inc

# Do not remove any partitions from rootfs (/boot is needed for rauc)
PARTITIONS_MOUNTPOINT_IMAGE:remove = "${STM32MP_BOOTFS_MOUNTPOINT_IMAGE}"
PARTITIONS_MOUNTPOINT_IMAGE:remove = "${STM32MP_USERFS_MOUNTPOINT_IMAGE}"
PARTITIONS_MOUNTPOINT_IMAGE:remove = "${STM32MP_VENDORFS_MOUNTPOINT_IMAGE}"

IMAGE_FSTYPES:remove = "ext4"

MACHINE_ESSENTIAL_EXTRA_RDEPENDS = " \
	kernel-devicetree \
	kernel-image \
	kernel-image-image \
"

STM32MP_DEVICETREE = "stm32mp257f-bytedevkit-v2"
BOOTSCHEME_LABELS = "optee"
BOOTDEVICE_LABELS = "emmc sdcard"

STM32MP_DEVICETREE_PROGRAMMER_ENABLE = "0"

# U-boot extra configuration
UBOOT_CONFIG = "default_stm32mp25"
UBOOT_CONFIG[default_stm32mp25] = "stm32mp257_bytedevkit_defconfig,,u-boot.dtb"
UBOOT_DEVICETREE[default_stm32mp25] = "stm32mp257f-bytedevkit"

# TF-A device tree for SD card
STM32MP_DT_FILES_SDCARD = "stm32mp257f-bytedevkit"

# TF-A device tree for eMMC
STM32MP_DT_FILES_EMMC = "stm32mp257f-bytedevkit"

# Optee dts
OPTEE_CONFIG[optee] = "stm32mp257f-bytedevkit,${OPTEE_CONFIG_OPTS_EXTDT} CFG_STM32MP_PROFILE=secure_and_system_services"

WKS_FILE = "stm32mp2-sdcard-tfa-optee.wks"
WKS_FILE_DEPENDS ?= " \
	e2fsprogs-native \
	fip-stm32mp \
	virtual/bootloader \
	virtual/trusted-firmware-a \
	${@bb.utils.contains('BOOTSCHEME_LABELS', 'optee', 'virtual-optee-os', '', d)} \
"

# Kernel is based on stm32mp257f, add stm32mp253f support with custom device
# trees.
STM32MP_KERNEL_DEVICETREE = " \
	st/stm32mp253f-bytedevkit-v1.dtb \
	st/stm32mp253f-bytedevkit-v2.dtb \
	st/stm32mp257f-bytedevkit-v1.dtb \
	st/stm32mp257f-bytedevkit-v2.dtb \
"
```

## wic/stm32mp2-sdcard-tfa-optee.wks
```
# short-description: Create SD card image for stm32mp2
# long-description: Creates a partitioned SD card image for stm32mp2

# FSBL partitions aka TF-A BL2
part fsbla1 --source rawcopy --fstype=ext4 --fsoptions "noauto" --part-name=fsbla1 --sourceparams="file=${DEPLOY_DIR_IMAGE}/arm-trusted-firmware/tf-a-stm32mp257f-bytedevkit-optee-sdcard.stm32" --ondisk mmcblk --part-type 0x8301 --fixed-size 256K --align 17
part fsbla2 --source rawcopy --fstype=ext4 --fsoptions "noauto" --part-name=fsbla2 --sourceparams="file=${DEPLOY_DIR_IMAGE}/arm-trusted-firmware/tf-a-stm32mp257f-bytedevkit-optee-sdcard.stm32" --ondisk mmcblk --part-type 0x8301 --fixed-size 256K

# Metadata partitions
part metadata1 --source rawcopy --fstype=ext4 --fsoptions "noauto" --part-name=metadata1 --sourceparams="file=${DEPLOY_DIR_IMAGE}/arm-trusted-firmware/metadata.bin" --ondisk mmcblk --part-type 0x8301 --fixed-size 256K
part metadata2 --source rawcopy --fstype=ext4 --fsoptions "noauto" --part-name=metadata2 --sourceparams="file=${DEPLOY_DIR_IMAGE}/arm-trusted-firmware/metadata.bin" --ondisk mmcblk --part-type 0x8301 --fixed-size 256K

# Fip partitions
part fip-a   --source rawcopy --fstype=ext4 --fsoptions "noauto" --part-name=fip-a --sourceparams="file=${DEPLOY_DIR_IMAGE}/fip/fip-stm32mp257f-bytedevkit-optee-sdcard.bin" --ondisk mmcblk --part-type 19d5df83-11b0-457b-be2c-7559c13142a5 --fixed-size 4096K --uuid 4fd84c93-54ef-463f-a7ef-ae25ff887087
part fip-b   --source rawcopy --fstype=ext4 --fsoptions "noauto" --part-name=fip-b --sourceparams="file=${DEPLOY_DIR_IMAGE}/fip/fip-stm32mp257f-bytedevkit-optee-sdcard.bin" --ondisk mmcblk --part-type 19d5df83-11b0-457b-be2c-7559c13142a5 --fixed-size 4096K --uuid 09c54952-d5bf-45af-acee-335303766fb3

# Rootfs
part /      --source rootfs --ondisk mmcblk0 --fstype=ext4 --label root --align 4096 --size 2G

bootloader --ptable gpt
```
